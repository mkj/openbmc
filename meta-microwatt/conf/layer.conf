## meta-microwatt/conf/layer.conf
```bitbake
# We have a conf and classes directory, add to BBPATH
BBPATH .= ":${LAYERDIR}"

# We have recipes-* directories, add to BBFILES
BBFILES += "${LAYERDIR}/recipes-*/*/*.bb \
            ${LAYERDIR}/recipes-*/*/*.bbappend"

BBFILE_COLLECTIONS += "microwatt-layer"
BBFILE_PATTERN_microwatt-layer := "^${LAYERDIR}/"
LAYERVERSION_microwatt-layer = "2"
LAYERSERIES_COMPAT_microwatt-layer = "gatesgarth hardknott honister"

# Add a few useful packages
IMAGE_INSTALL:append = "strace ldd systemd-bootchart systemd-analyze gdb"
```
